## boards/shields/Kconfig.shield
```kconfig
# No whitespace after the comma or in the keyboard name!
config corne_dongle
    def_bool $(shields_list_contains,my_keyboard_dongle)
```

## config/boards/shields/ellacorne/Kconfig.shield
```kconfig
# No whitespace after the comma or in the keyboard name!
config SHIELD_ELLACORNE_DONGLE
    def_bool $(shields_list_contains,ellacorne_d)

config SHIELD_ELLACORNE_LEFT
    def_bool $(shields_list_contains,ellacorne_l)

config SHIELD_ELLACORNE_LEFT
    def_bool $(shields_list_contains,ellacorne_r)
```

## config/boards/shields/nice_view_custom_l/Kconfig.shield
```kconfig
# Copyright (c) 2022 The ZMK Contributors
# SPDX-License-Identifier: MIT

config SHIELD_NICE_VIEW_CUSTOM_L
    def_bool $(shields_list_contains,nice_view_custom_l)
```
